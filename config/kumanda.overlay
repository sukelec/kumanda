/ {
    chosen {
        zmk,kscan = &kscan0;
    };

    kscan0: kscan_direct {
        compatible = "zmk,kscan-gpio-direct";
        label = "KSCAN";
        input-gpios
            = <&gpio0  6 (GPIO_ACTIVE_LOW | GPIO_PULL_UP)> // Buton 1 (P0.06)
            , <&gpio0  8 (GPIO_ACTIVE_LOW | GPIO_PULL_UP)> // Buton 2 (P0.08)
            , <&gpio0 17 (GPIO_ACTIVE_LOW | GPIO_PULL_UP)> // Buton 3 (P0.17)
            , <&gpio0 20 (GPIO_ACTIVE_LOW | GPIO_PULL_UP)> // Buton 4 (P0.20)
            , <&gpio0 22 (GPIO_ACTIVE_LOW | GPIO_PULL_UP)> // Buton 5 (P0.22)
            , <&gpio0 24 (GPIO_ACTIVE_LOW | GPIO_PULL_UP)> // Buton 6 (P0.24)
            , <&gpio1  0 (GPIO_ACTIVE_LOW | GPIO_PULL_UP)> // Buton 7 (P1.00)
            , <&gpio0 11 (GPIO_ACTIVE_LOW | GPIO_PULL_UP)> // Buton 8 (P0.11)
            ;
    };
};